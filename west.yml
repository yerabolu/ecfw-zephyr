## west.yml
```yaml
# The west manifest file for the Zephyr EC FW.
#
# The per-installation west configuration file specifies the location of this
# manifest file. The "path" option in the [manifest] section of .west/config
# defines the folder that contains west.yml. The path is relative to the folder
# that contains .west.
#

west:
  url: https://github.com/zephyrproject-rtos/west
  version: v0.7.2

manifest:
  defaults:
    remote: github_restricted

  remotes:
    - name: zephyrproject
      url-base: https://github.com/zephyrproject-rtos
    - name: github_restricted
      url-base: https://github.com/intel-restricted

  # The list of dependencies
  #
  projects:
    # EC team zephyr RTOS fork
    # This repo sometimes contains delta changes on top of an official
    # Zephyr RTOS public release
    - name: zephyr_public
      repo-path: zephyr.git
      path: ecfwwork/zephyr_fork
      remote: zephyrproject
      revision: d4d20c58260d1df9533a2253762c384031dc721b
      #clone-depth: 1
      west-commands: scripts/west-commands.yml

    - name: cmsis
      path: ecfwwork/modules/hal/cmsis
      remote: zephyrproject
      revision: 093de61c2a7d12dc9253daf8692f61f793a9254a

    - name: hal_microchip
      path: ecfwwork/modules/hal/microchip
      remote: zephyrproject
      revision: 5d079f1683a00b801373bbbbf5d181d4e33b30d5

  self:
    path: ecfwwork
```
